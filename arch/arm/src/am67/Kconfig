## arch/arm/src/am67/Kconfig
```kconfig
#
# For a description of the syntax of this configuration file,
# see the file kconfig-language.txt in the NuttX tools repository.
#

comment "AM67 Configuration Options"

config ARCH_LOWPUTC
	bool
	default y
	---help---
		The AM67 serial console (16550) provides up_putc(), polled
		low-level character output that works even from panic/assert
		context with interrupts disabled.  Declaring ARCH_LOWPUTC lets
		SYSLOG_DEFAULT and the assert dump use it.

config AM67_GPIO
	bool "AM67 padconfig GPIO driver"
	default y
	---help---
		Enable the AM67 GPIO driver used by PX4 board support and
		example applications (LED, IMU_EN, SPI CS padconfig).


config AM67_EPWM0
	bool "AM67 EPWM0 driver"
	default n
	depends on PWM
	select ARCH_HAVE_PWM_MULTICHAN
	---help---
		Enable EPWM driver on EPWM0 (outputs A and B; requires
		PWM_MULTICHAN with PWM_NCHANNELS >= 2)

config AM67_EPWM1
	bool "AM67 EPWM1 driver"
	default n
	depends on PWM
	select ARCH_HAVE_PWM_MULTICHAN
	---help---
		Enable EPWM driver on EPWM1 (outputs A and B on HAT GPIO-6
		and GPIO-13; requires PWM_MULTICHAN with PWM_NCHANNELS >= 2).
		EPWM2 is the board cooling fan and is deliberately not
		supported.


config AM67_ECAP0
	bool "AM67 eCAP0 APWM driver"
	default n
	depends on PWM
	---help---
		Enable the eCAP0 module as a single-channel Auxiliary PWM
		(APWM) output.  Registered as /dev/ecap0 (kept out of the
		/dev/pwmN namespace, which belongs to the EPWM instances).
		The default output pad is ball A23 (mode 8 =
		ECAP0_IN_APWM0_OUT), chosen to avoid the C20 collision with
		EPWM0_B; confirm it reaches the HAT header before relying on
		it.

config AM67_ECAP1
	bool "AM67 eCAP1 APWM driver"
	default n
	depends on PWM
	---help---
		Enable the eCAP1 module as a single-channel APWM output,
		registered as /dev/ecap1.  Output pad selection is a board TODO
		(candidates collide with I2C0); see am67_pinmux.c.

config AM67_ECAP2
	bool "AM67 eCAP2 APWM driver"
	default n
	depends on PWM
	---help---
		Enable the eCAP2 module as a single-channel APWM output,
		registered as /dev/ecap2.  Output pad selection is a board TODO
		(candidates collide with I2C0); see am67_pinmux.c.


config AM67_MCSPI0
	bool "AM67 MCU_MCSPI0 master driver"
	default n
	depends on SPI
	---help---
		Enable polled SPI master on MCU_MCSPI0 @ 0x04b00000 (onboard
		ICM-20948 CS3 and LPS22DF CS1).

if AM67_MCSPI0

config AM67_MCSPI0_FCLK
	int "MCU_MCSPI0 functional clock (Hz)"
	default 48000000

endif

config AM67_RESET_ON_FATAL
	bool "Reset the SoC after a watchdog expiry or fatal error"
	default n
	depends on AM67_RTI8_WDT
	---help---
		After cutting the motor outputs, the watchdog FIQ handler (and
		board code on a fatal error) ask the DM for a SoC reset
		(TISCI SYS_RESET) instead of halting the core: the core restarts
		through U-Boot without waiting for Linux or a power cycle.  The
		watchdog record (g_am67_wdt_fiq_info) goes to section
		.am67_noinit, which the board linker script must place in DDR
		outside every loaded segment, so it survives the reset and is
		reported at the next start.

config AM67_DDR_READ_ORDERID
	int "MAIN R5F DDR read order ID (QoS)"
	default 0
	range 0 15
	---help---
		Order ID of this core's reads in its QoS endpoint
		(PULSAR_UL_MAIN_0_CPU0_RMST channel 0); 0 keeps the reset value.
		Order IDs 8-15 take the DDR controller's high-priority path, as
		U-Boot sets for the display (15). With Linux loading DDR on all
		four A53 cores, 15 gave the PX4 core 2.7 points more idle time
		and about 12 us less control latency on the T3 Gemstone O1.

config AM67_TICK_TIMER
	int "MAIN DMTimer instance for the system tick"
	default 0
	range 0 2
	---help---
		MAIN DMTimer that drives the NuttX system tick (0: 0x02400000,
		IRQ 24; 1: IRQ 25; 2: 0x02420000, IRQ 26). U-Boot uses DMTimer0
		as its own tick, so a core that U-Boot starts before Linux must
		not use 0. The timer is powered through TISCI before use.

config AM67_RPTUN_NET_VDEV
	bool "Resource table: virtio-net vdev next to RPMsg"
	default y
	depends on RPTUN
	---help---
		List a virtio-net vdev (for vhost-net) in the resource table.
		Without it the table holds only the RPMsg vdev, and every entry
		Linux has to parse lies within the 256 bytes it reads when it
		attaches to a core that is already running (IPC-only mode).

config AM67_RTI8_WDT
	bool "AM67 RTI8 watchdog for MAIN R5F core 0 (FIQ motor cut)"
	default n
	select ARMV7R_DECODEFIQ
	select ARMV7R_FIQ_NMI
	---help---
		RTI8 windowed watchdog with an NMI reaction routed as FIQ. The
		FIQ handler cuts the EPWM/eCAP outputs, records the hung context
		in g_am67_wdt_fiq_info and halts the core. The caller starts and
		kicks it (am67_rti.h).

config AM67_DSHOT
	bool "AM67 DShot on the EPWM motor outputs (FIQ bit engine)"
	default n
	depends on AM67_EPWM0 && AM67_EPWM1
	select ARMV7R_DECODEFIQ
	select ARMV7R_FIQ_NMI
	---help---
		DShot150/300/600 on EPWM0 A/B and EPWM1 A/B. Each counter
		period is one bit with shadowed compares; a FIQ at CTR = 0
		(EPWM0 event trigger, VIM 36) writes the next bit from ATCM.

config AM67_SDHCI0
	bool "AM67 MMCSD0 (eMMC) SDIO driver"
	default n
	select ARCH_HAVE_SDIO
	select SDIO_BLOCKSETUP
	---help---
		The on-board eMMC on MMCSD0 as an SDIO lower half for
		drivers/mmcsd: 4-bit, legacy timing at 20 MHz, programmed I/O.
		Linux must leave sdhci0 disabled.

config AM67_FAULT_INJECTION
	bool "Driver fault injection for bench tests"
	default n
	---help---
		Lets a test command make MCSPI and SDHCI transfers fail on
		request, to exercise their error and recovery paths on the bench.
		Never enable in a flight image.

config AM67_I2C
	bool "AM67 I2C support"
	default n
	depends on I2C

if AM67_I2C

config AM67_I2C0
	bool "AM67 MCU_I2C0 driver (MCU domain, 0x04900000)"
	default n
	---help---
		Enable the I2C master driver for MCU_I2C0.

config AM67_WKUP_I2C0
	bool "AM67 WKUP_I2C0 driver (WKUP domain, 0x2b200000)"
	default n
	---help---
		Enable the I2C master driver for WKUP_I2C0.

endif # AM67_I2C
```

## arch/arm/src/am67a_mcu/Kconfig
```kconfig
#
# For a description of the syntax of this configuration file,
# see the file kconfig-language.txt in the NuttX tools repository.
#

if ARCH_CHIP_AM67A_MCU

config SOC_AM67A_MCU_R5F
	bool "TI AM67A MCU Domain Cortex-R5F"
	default y
	select ARCH_CORTEXR5
	select ARCH_ARMV7R
	select ARMV7R_HAVE_MPU
	select ARCH_HAVE_MPU
	select ARMV7R_MEMINIT
	select ARCH_HAVE_LOWVECTORS
	select ARCH_LOWVECTORS
	---help---
		Texas Instruments AM67A MCU Domain Cortex-R5F core (mcu-r5f0_0).

menu "AM67A MCU Peripheral Selection"

config AM67A_MCU_UART0
	bool "MCU UART0"
	default y
	---help---
		Enable MCU Domain UART0 peripheral.

config AM67A_MCU_RTI0
	bool "MCU RTI0 (Timer)"
	default y
	---help---
		Enable MCU Domain RTI0 timer for system tick.

config AM67A_MCU_RPTUN
	bool "AM67A MCU RemoteProc Tunnel (RPTun)"
	default n
	select RPTUN
	---help---
		Enable AM67A MCU RemoteProc Tunnel driver for IPC communication with
		Linux (A53) via TI Hardware Mailbox Cluster 1.

config AM67A_MCU_MCSPI0
	bool "MCU MCSPI0"
	default n
	select SPI
	---help---
		Enable AM67A MCU Domain MCSPI0 peripheral.

config AM67A_MCU_MCSPI1
	bool "MCU MCSPI1"
	default n
	select SPI
	---help---
		Enable AM67A MCU Domain MCSPI1 peripheral.

config AM67A_MCU_MCSPI_FCLK
	int "MCU MCSPI Functional Clock Frequency (Hz)"
	default 50000000
	depends on AM67A_MCU_MCSPI0 || AM67A_MCU_MCSPI1
	---help---
		Input reference clock frequency for MCU MCSPI instances.
		Default is 50000000 (50 MHz) as configured in MCU+ SDK.

config AM67A_MCU_I2C0
	bool "MCU I2C0 (0x04900000)"
	default n
	select I2C
	---help---
		Enable AM67A MCU Domain MCU_I2C0 master peripheral at 0x04900000.

config AM67A_MCU_I2C0_FCLK
	int "MCU I2C0 Functional Clock Frequency (Hz)"
	default 96000000
	depends on AM67A_MCU_I2C0
	---help---
		Input reference clock frequency for MCU_I2C0. Default is 96000000 (96 MHz).

config AM67A_MCU_EPWM
	bool "MCU EPWM"
	default n
	select PWM
	---help---
		Enable AM67A MCU Domain EPWM driver.

config AM67A_MCU_HRT
	bool "High Resolution Timer (HRT)"
	default y
	---help---
		Enable High Resolution Timer (HRT) driver using MCU_TIMER1.

endmenu

endif # ARCH_CHIP_AM67A_MCU
```
